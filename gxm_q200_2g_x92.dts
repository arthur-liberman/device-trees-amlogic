#include "gxm_q200_2g.dts"

/ {
	le-dt-id = "gxm_q200_2g_x92";

	fd628_dev {
		compatible = "amlogic,fd628_dev";
		status = "okay";
		fd628_gpio_clk = <&gpio GPIODV_16 GPIO_ACTIVE_HIGH>;
		fd628_gpio_dat = <&gpio GPIODV_15 GPIO_ACTIVE_HIGH>;
		fd628_gpio_stb = <&gpio GPIODV_17 GPIO_ACTIVE_HIGH>;
		/* < DHHMM > Order of display chars (D=dots, represented by a single char) */
		fd628_chars = /bits/ 8 <4 0 1 2 3>;
		/* Dot enumeration */
		/* Apps = 0, Setup = 1, USB = 2, Card = 3, Col = 4, HDMI = 5, CVBS = 6 */
		fd628_dot_bits = /bits/ 8 <0 1 2 3 4 5 6>;
		/* Display type			Ctrl.	Flags	Rsrvd.	Type */
		fd628_display_type = /bits/ 8 <	0x00	0x01	0x00	0x02 >;
	};

};
