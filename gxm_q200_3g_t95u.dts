#include "gxm_q200_3g.dts"

/ {
	le-dt-id = "gxm_q200_3g_t95u";

	fd628_dev {
		compatible = "amlogic,fd628_dev";
		status = "okay";
		fd628_gpio_clk = <&gpio GPIODV_22 GPIO_ACTIVE_HIGH>;
		fd628_gpio_dat = <&gpio GPIODV_23 GPIO_ACTIVE_HIGH>;
		fd628_gpio_stb = <&gpio GPIODV_21 GPIO_ACTIVE_HIGH>;
		/* < DHHMM > Order of display chars (D=dots, represented by a single char) */
		fd628_chars = /bits/ 8 <4 0 1 2 3>;
		/* Dot enumeration */
		/* Alarm = 0, USB = 1, Play = 2, Pause = 3, Col = 4, Eth = 5, Wifi = 6 */
		fd628_dot_bits = /bits/ 8 <0 1 2 3 4 5 6>;
		/* Display type			Ctrl.	Flags	Rsrvd.	Type */
		fd628_display_type = /bits/ 8 <	0x00	0x00	0x00	0x00 >;
	};

};
