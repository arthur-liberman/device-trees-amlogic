#include "gxl_p281_2g.dts"

/ {
	le-dt-id = "gxl_p281_2g_a95xr2";

	pinmux {
		/delete-node/ internal_eth_pins;
	};

	fd628_dev {
		compatible = "amlogic,fd628_dev";
		status = "okay";
		fd628_gpio_clk = <&gpio GPIOZ_14 GPIO_ACTIVE_HIGH>;
		fd628_gpio_dat = <&gpio GPIOZ_15 GPIO_ACTIVE_HIGH>;
		fd628_gpio_stb = <&gpio_ao GPIOAO_9 GPIO_ACTIVE_HIGH>;
		/* < DHHMM > Order of display chars (D=dots, represented by a single char) */
		fd628_chars = /bits/ 8 <4 0 1 2 3>;
		/* Dot enumeration */
		/* N/A = 0, N/A = 1, Power = 2, LAN = 3, Col = 4, Low Wifi = 5, High Wifi = 6 */
		fd628_dot_bits = /bits/ 8 <0 1 2 3 4 5 6>;
		/* Display type			Ctrl.	Flags	Rsrvd.	Type */
		fd628_display_type = /bits/ 8 <	0x00	0x00	0x00	0x03 >;
	};

};
