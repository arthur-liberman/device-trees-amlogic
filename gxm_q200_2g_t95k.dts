#include "gxm_q200_2g.dts"

/ {
	le-dt-id = "gxm_q200_2g_t95k";

	fd628_dev {
		compatible = "amlogic,fd628_dev";
		status = "okay";
		fd628_gpio_clk = <&gpio GPIODV_22 GPIO_ACTIVE_HIGH>;
		fd628_gpio_dat = <&gpio GPIODV_23 GPIO_ACTIVE_HIGH>;
		fd628_gpio_stb = <&gpio GPIODV_21 GPIO_ACTIVE_HIGH>;
		/* < DHHMM > Order of display chars (D=dots, represented by a single char) */
		fd628_chars = /bits/ 8 <4 0 1 2 3>;
		/* Dot enumeration */
		/* N/A = 0, N/A = 1, N/A = 2, N/A = 3, Col = 4, N/A = 5, N/A = 6 */
		fd628_dot_bits = /bits/ 8 <0 1 2 3 4 5 6>;
		/* Display type			Ctrl.	Flags	Rsrvd.	Type */
		fd628_display_type = /bits/ 8 <	0x01	0x00	0x00	0x04 >;
	};

};
